## app/boards/arm/seeeduino_xiao_ble/Kconfig.board
```kconfig
# Seeeduino XIAO BLE board configuration

# Copyright (c) 2024 The ZMK Contributors
# SPDX-License-Identifier: MIT

config BOARD_SEEEDUINO_XIAO_BLE
	bool "Seeeduino XIAO BLE"
	depends on SOC_NRF52840_QIAA
```

## app/boards/arm/seeeduino_xiao_ble/Kconfig.defconfig
```kconfig
# Seeeduino XIAO BLE board configuration

# Copyright (c) 2024 The ZMK Contributors
# SPDX-License-Identifier: MIT

config BOARD
	default "seeeduino_xiao_ble"

if USB

config USB_NRFX
	default y

config USB_DEVICE_STACK
	default y

endif # USB

config BT_CTLR
	default BT

config ZMK_BLE
	default y

config ZMK_USB
	default y

config ZMK_BATTERY_VOLTAGE_DIVIDER
	default y
```

## app/boards/shields/corne_tpsg_sxb/Kconfig.defconfig
```kconfig
if SHIELD_CORNE_TPSG_SXB_LEFT

config ZMK_KEYBOARD_NAME
	default "CorneTPSGSXBL"

endif

if SHIELD_CORNE_TPSG_SXB_RIGHT

config ZMK_KEYBOARD_NAME
	default "Corne_TPSG_SXB"
	
config ZMK_SPLIT_BLE_ROLE_CENTRAL
	default y
	
endif

if SHIELD_CORNE_TPSG_SXB_LEFT || SHIELD_CORNE_TPSG_SXB_RIGHT

config ZMK_SPLIT
	default y

endif

if USB

config USB_NRFX
	default y

config USB_DEVICE_STACK
	default y

endif # USB

config ZMK_BLE
	default y

config ZMK_USB
	default y

config ZMK_BATTERY_VOLTAGE_DIVIDER
	default y
```

## app/boards/shields/corne_tpsg_sxb/Kconfig.shield
```kconfig
# Copyright (c) 2022 KyouTansan
# SPDX-License-Identifier: MIT

config SHIELD_CORNE_TPSG_SXB_LEFT
	def_bool $(shields_list_contains,corne_tpsg_sxb_left)

config SHIELD_CORNE_TPSG_SXB_RIGHT
	def_bool $(shields_list_contains,corne_tpsg_sxb_right)
```

## app/boards/shields/wings42_sg/Kconfig.defconfig
```kconfig
if SHIELD_WINGS42_SG_LEFT

config ZMK_KEYBOARD_NAME
	default "Wings42_SG Left"

endif

if SHIELD_WINGS42_SG_RIGHT

config ZMK_KEYBOARD_NAME
	default "Wings42_SG"
	
config ZMK_SPLIT_BLE_ROLE_CENTRAL
	default y
	
endif

if SHIELD_WINGS42_SG_LEFT || SHIELD_WINGS42_SG_RIGHT

config ZMK_SPLIT
	default y

# config  ZMK_KSCAN_COMPOSITE_DRIVER
#	default y

endif
```

## app/boards/shields/wings42_sg/Kconfig.shield
```kconfig
# Copyright (c) 2022 KyouTansan
# SPDX-License-Identifier: MIT

config SHIELD_WINGS42_SG_LEFT
	def_bool $(shields_list_contains,wings42_sg_left)

config SHIELD_WINGS42_SG_RIGHT
	def_bool $(shields_list_contains,wings42_sg_right)
```

## app/boards/shields/wings42_sg_sxb/Kconfig.defconfig
```kconfig
if SHIELD_WINGS42_SG_SXB_LEFT

config ZMK_KEYBOARD_NAME
	default "Wings42_SG_SXB Left"

endif

if SHIELD_WINGS42_SG_SXB_RIGHT

config ZMK_KEYBOARD_NAME
	default "Wings42_SG_SXB"
	
config ZMK_SPLIT_BLE_ROLE_CENTRAL
	default y
	
endif

if SHIELD_WINGS42_SG_SXB_LEFT || SHIELD_WINGS42_SG_SXB_RIGHT

config ZMK_SPLIT
	default y

endif

if USB

config USB_NRFX
	default y

config USB_DEVICE_STACK
	default y

endif # USB

config ZMK_BLE
	default y

config ZMK_USB
	default y

config ZMK_BATTERY_VOLTAGE_DIVIDER
	default y
```

## app/boards/shields/wings42_sg_sxb/Kconfig.shield
```kconfig
# Copyright (c) 2022 KyouTansan
# SPDX-License-Identifier: MIT

config SHIELD_WINGS42_SG_SXB_LEFT
	def_bool $(shields_list_contains,wings42_sg_sxb_left)

config SHIELD_WINGS42_SG_SXB_RIGHT
	def_bool $(shields_list_contains,wings42_sg_sxb_right)
```

## app/boards/shields/wings42_tpsg/Kconfig.defconfig
```kconfig
if SHIELD_WINGS42_TPSG_LEFT

config ZMK_KEYBOARD_NAME
	default "Wings42_TPSG L"

endif

if SHIELD_WINGS42_TPSG_RIGHT

config ZMK_KEYBOARD_NAME
	default "Wings42_TPSG"
	
config ZMK_SPLIT_BLE_ROLE_CENTRAL
	default y
	
endif

if SHIELD_WINGS42_TPSG_LEFT || SHIELD_WINGS42_TPSG_RIGHT

config ZMK_SPLIT
	default y

config ZMK_KSCAN_COMPOSITE_DRIVER
	default y

endif
```

## app/boards/shields/wings42_tpsg/Kconfig.shield
```kconfig
# Copyright (c) 2022 KyouTansan
# SPDX-License-Identifier: MIT

config SHIELD_WINGS42_TPSG_LEFT
	def_bool $(shields_list_contains,wings42_tpsg_left)

config SHIELD_WINGS42_TPSG_RIGHT
	def_bool $(shields_list_contains,wings42_tpsg_right)
```

## app/drivers/sensor/track_point/Kconfig
```kconfig
# Copyright (c) 2020 The ZMK Contributors
# SPDX-License-Identifier: MIT

config ZMK_TRACK_POINT
	bool "ZMK track point strain gauge"
	select ADC
	help
	  Enable ZMK track point driver with strain gauge.

config ZMK_TRACK_POINT_VARIANCE
	int "zmk track point value calibration"
	default 10
	help
	  Calibration strain gauge value by variance of ADC value.
	  
config ZMK_TRACK_POINT_SCAN_TIME
	int "ZMK track point scan period"
	default 50
	help
	  msec.
	
config ZMK_TRACK_POINT_REDUCE_POWER_CONSUMPTION
       bool "Reduce power for zmk track point strain gauge."
       help
	 Reduce power consumption of ZMK track point strain gauge.

config ZMK_TRACK_POINT_POWER_CHARGE_UP_TIME
       int "Init charge up time for strain gauge and OPAmp"
       default 0
       help
         Init charge up time for strain gauge and ope-amp.


config ZMK_TRACK_POINT_ATTEN_X_SQUARE_PLUS_CP
       int "X-square attenuation due to Wheatstone bridge for plus/right area on constant power consumption mode"
       default 13
       help
         X-square attenuation due to Wheatstone bridge for plus/right area on constant power consumption mode.

config ZMK_TRACK_POINT_ATTEN_X_SQUARE_MINUS_CP
       int "X-square attenuation due to Wheatstone bridge for minus/left area on constant power consumption mode"
       default 13
       help
         X-square attenuation due to Wheatstone bridge for minus/left area on constant power consumption mode.

config ZMK_TRACK_POINT_ATTEN_Y_SQUARE_PLUS_CP
       int "Y-square attenuation due to Wheatstone bridge for plus/down area on constant power consumption mode"
       default 13
       help
         Y-square attenuation due to Wheatstone bridge for plus/down area on constant power consumption mode.

config ZMK_TRACK_POINT_ATTEN_Y_SQUARE_MINUS_CP
       int "Y-square attenuation due to Wheatstone bridge for minus/up area on constant power consumption mode"
       default 13
       help
         Y-square attenuation due to Wheatstone bridge for minus/up area on constant power consumption mode.


config ZMK_TRACK_POINT_ATTEN_X_SQUARE_PLUS_RP
       int "X-square attenuation due to Wheatstone bridge for plus/right area on reduce power consumption mode"
       default 10
       help
         X-square attenuation due to Wheatstone bridge for plus/right area on reduce power consumption mode.

config ZMK_TRACK_POINT_ATTEN_X_SQUARE_MINUS_RP
       int "X-square attenuation due to Wheatstone bridge for minus/left area on reduce power consumption mode"
       default 13
       help
         X-square attenuation due to Wheatstone bridge for minus/left area on reduce power consumption mode.

config ZMK_TRACK_POINT_ATTEN_Y_SQUARE_PLUS_RP
       int "Y-square attenuation due to Wheatstone bridge for plus/down area on reduce power consumption mode"
       default 12
       help
         Y-square attenuation due to Wheatstone bridge for plus/down area on reduce power consumption mode.

config ZMK_TRACK_POINT_ATTEN_Y_SQUARE_MINUS_RP
       int "Y-square attenuation due to Wheatstone bridge for minus/up area on reduce power consumption mode"
       default 11
       help
         Y-square attenuation due to Wheatstone bridge for minus/up area on reduce power consumption mode.
```

## app/drivers/sensor/trackpoint_tpsg/Kconfig
```kconfig
# Copyright (c) 2020 The ZMK Contributors
# SPDX-License-Identifier: MIT

config ZMK_TPSG
	bool "ZMK track point strain gauge"
	select ADC
	help
	  Enable ZMK track point driver with strain gauge.

config ZMK_TPSG_VARIANCE
	int "zmk track point value calibration"
	default 10
	help
	  Calibration strain gauge value by variance of ADC value.
	  
config ZMK_TPSG_SCAN_TIME
	int "ZMK track point scan period"
	default 50
	help
	  msec.
	
config ZMK_TPSG_REDUCE_POWER_CONSUMPTION
       bool "Reduce power for zmk track point strain gauge."
       help
	 Reduce power consumption of ZMK track point strain gauge.

config ZMK_TPSG_REDUCE_POWER_CONSUMPTION_USB
       bool "The zmk trackpoint strain gauge also reduces USB power."
       help
	 Reduce power consumption of ZMK track point strain gauge anytime.

config ZMK_TPSG_POWER_CHARGE_UP_TIME
       int "Init charge up time for strain gauge and OPAmp"
       default 0
       help
         Init charge up time for strain gauge and ope-amp.

#config ZMK_TPSG_WHEASTONE_BRIDGE_TUNING
#       bool "The zmk trackpoint strain gauge tuning."
#       help
#	 Set value as target.


config ZMK_TPSG_ATTEN_X_SQUARE_PLUS_CP
       int "X-squared attenuation due to Wheatstone bridge for plus/right area while constant power consumption mode"
       default 13
       help
         X-squared attenuation due to Wheatstone bridge for plus/right area while constant power consumption mode.

config ZMK_TPSG_ATTEN_X_SQUARE_MINUS_CP
       int "X-squared attenuation due to Wheatstone bridge for minus/left area while constant power consumption mode"
       default 13
       help
         X-squared attenuation due to Wheatstone bridge for minus/left area while constant power consumption mode.

config ZMK_TPSG_ATTEN_Y_SQUARE_PLUS_CP
       int "Y-squared attenuation due to Wheatstone bridge for plus/down area while constant power consumption mode"
       default 13
       help
         Y-squared attenuation due to Wheatstone bridge for plus/down area while constant power consumption mode.

config ZMK_TPSG_ATTEN_Y_SQUARE_MINUS_CP
       int "Y-squared attenuation due to Wheatstone bridge for minus/up area while constant power consumption mode"
       default 13
       help
         Y-squared attenuation due to Wheatstone bridge for minus/up area while constant power consumption mode.


config ZMK_TPSG_ATTEN_X_SQUARE_PLUS_RP
       int "X-squared attenuation due to Wheatstone bridge for plus/right area while reduce power consumption mode"
       default 10
       help
         X-squared attenuation due to Wheatstone bridge for plus/right area while reduce power consumption mode.

config ZMK_TPSG_ATTEN_X_SQUARE_MINUS_RP
       int "X-squared attenuation due to Wheatstone bridge for minus/left area while reduce power consumption mode"
       default 13
       help
         X-squared attenuation due to Wheatstone bridge for minus/left area while reduce power consumption mode.

config ZMK_TPSG_ATTEN_Y_SQUARE_PLUS_RP
       int "Y-squared attenuation due to Wheatstone bridge for plus/down area while reduce power consumption mode"
       default 12
       help
         Y-squared attenuation due to Wheatstone bridge for plus/down area while reduce power consumption mode.

config ZMK_TPSG_ATTEN_Y_SQUARE_MINUS_RP
       int "Y-squared attenuation due to Wheatstone bridge for minus/up area while reduce power consumption mode"
       default 11
       help
         Y-squared attenuation due to Wheatstone bridge for minus/up area while reduce power consumption mode.


# -------------------------------------------------------------------------------------------------------------------
config ZMK_TPSG_AXPC
       int "X-squared attenuation due to Wheatstone bridge for plus/right area while constant power consumption mode"
       default 13
       help
         X-squared attenuation due to Wheatstone bridge for plus/right area while constant power consumption mode.

config ZMK_TPSG_AXMC
       int "X-squared attenuation due to Wheatstone bridge for minus/left area while constant power consumption mode"
       default 13
       help
         X-squared attenuation due to Wheatstone bridge for minus/left area while constant power consumption mode.

config ZMK_TPSG_AYPC
       int "Y-squared attenuation due to Wheatstone bridge for plus/down area while constant power consumption mode"
       default 13
       help
         Y-squared attenuation due to Wheatstone bridge for plus/down area while constant power consumption mode.

config ZMK_TPSG_AYMC
       int "Y-squared attenuation due to Wheatstone bridge for minus/up area while constant power consumption mode"
       default 13
       help
         Y-squared attenuation due to Wheatstone bridge for minus/up area while constant power consumption mode.

config ZMK_TPSG_AXPR
       int "X-squared attenuation due to Wheatstone bridge for plus/right area while reduce power consumption mode"
       default 10
       help
         X-squared attenuation due to Wheatstone bridge for plus/right area while reduce power consumption mode.

config ZMK_TPSG_AXMR
       int "X-squared attenuation due to Wheatstone bridge for minus/left area while reduce power consumption mode"
       default 13
       help
         X-squared attenuation due to Wheatstone bridge for minus/left area while reduce power consumption mode.

config ZMK_TPSG_AYPR
       int "Y-squared attenuation due to Wheatstone bridge for plus/down area while reduce power consumption mode"
       default 12
       help
         Y-squared attenuation due to Wheatstone bridge for plus/down area while reduce power consumption mode.

config ZMK_TPSG_AYMR
       int "Y-squared attenuation due to Wheatstone bridge for minus/up area while reduce power consumption mode"
       default 11
       help
         Y-squared attenuation due to Wheatstone bridge for minus/up area while reduce power consumption mode.


# -------------------------------------------------------------------------------------------------------------------
config ZMK_TPSG_BXPC
       int "X attenuation due to Wheatstone bridge for plus/right area while constant power consumption mode"
       default 1
       help
         X attenuation due to Wheatstone bridge for plus/right area while constant power consumption mode.

config ZMK_TPSG_BXMC
       int "X attenuation due to Wheatstone bridge for minus/left area while constant power consumption mode"
       default 1
       help
         X attenuation due to Wheatstone bridge for minus/left area while constant power consumption mode.

config ZMK_TPSG_BYPC
       int "Y attenuation due to Wheatstone bridge for plus/down area while constant power consumption mode"
       default 1
       help
         Y attenuation due to Wheatstone bridge for plus/down area while constant power consumption mode.

config ZMK_TPSG_BYMC
       int "Y attenuation due to Wheatstone bridge for minus/up area while constant power consumption mode"
       default 1
       help
         Y attenuation due to Wheatstone bridge for minus/up area while constant power consumption mode.

config ZMK_TPSG_BXPR
       int "X attenuation due to Wheatstone bridge for plus/right area while reduce power consumption mode"
       default 2
       help
         X attenuation due to Wheatstone bridge for plus/right area while reduce power consumption mode.

config ZMK_TPSG_BXMR
       int "X attenuation due to Wheatstone bridge for minus/left area while reduce power consumption mode"
       default 5
       help
         X attenuation due to Wheatstone bridge for minus/left area while reduce power consumption mode.

config ZMK_TPSG_BYPR
       int "Y attenuation due to Wheatstone bridge for plus/down area while reduce power consumption mode"
       default 7
       help
         Y attenuation due to Wheatstone bridge for plus/down area while reduce power consumption mode.

config ZMK_TPSG_BYMR
       int "Y attenuation due to Wheatstone bridge for minus/up area while reduce power consumption mode"
       default 5
       help
         Y attenuation due to Wheatstone bridge for minus/up area while reduce power consumption mode.
```
