## app/drivers/zephyr/dts/bindings/sensor/zmk,track-point.yaml
```yaml
# Copyright (c) 2020 The ZMK Contributors
# SPDX-License-Identifier: MIT

description: TrackPoint driver

compatible: "zmk,track-point"


properties:
    label:
      required: true
      type: string

    io-channels:
      type: phandle-array
      required: true
      description: |
        Channels available with this divider configuration.

    power-gpios:
      type: phandle-array
      required: false
      description: |
        Control power to the voltage divider inputs.

        If present the corresponding GPIO must be set to an active level
        to enable the divider input.
```

## app/drivers/zephyr/dts/bindings/sensor/zmk,trackpoint-strain-gauge.yaml
```yaml
# Copyright (c) 2020 The ZMK Contributors
# SPDX-License-Identifier: MIT

description: Trackpoint Strain Gauge driver

compatible: "zmk,trackpoint-strain-gauge"


properties:
    label:
      required: true
      type: string

    io-channels:
      type: phandle-array
      required: true
      description: |
        Channels available with this divider configuration.

    power-gpios:
      type: phandle-array
      required: false
      description: |
        Control power to the strain gauge wheatstone bridge and op-amp.

        If present the corresponding GPIO must be set to an active level
        to enable it.
```
