/*
 * Copyright (c) 2022 Peter Johanson
 *
 * SPDX-License-Identifier: Apache-2.0
 */

/dts-v1/;
#include "seeeduino_xiao_ble.dtsi"
#include "seeed_xiao_connector.dtsi"

/ {
	vbatt {
		compatible = "zmk,battery-voltage-divider";
		label = "BATTERY";
		io-channels = <&adc 7>;
		power-gpios = <&gpio0 14 (GPIO_OPEN_DRAIN | GPIO_ACTIVE_LOW)>;
		output-ohms = <510000>;
		full-ohms = <(1000000 + 510000)>;
	};
};
